## components/crt_core/Kconfig
```kconfig
menu "CRT Core"

choice CRT_VIDEO_STANDARD
    prompt "Composite video standard"
    default CRT_VIDEO_STANDARD_NTSC
    help
        Select the composite timing profile used by the CRT core.

config CRT_VIDEO_STANDARD_NTSC
    bool "NTSC-M (525/60)"

config CRT_VIDEO_STANDARD_PAL
    bool "PAL-B/G (625/50)"

config CRT_VIDEO_STANDARD_PAL_M
    bool "PAL-M (Brazil, 525/60)"

config CRT_VIDEO_STANDARD_PAL_N
    bool "PAL-N (Argentina/Paraguay/Uruguay, 625/50)"

endchoice

config CRT_ENABLE_COLOR
    bool "Enable composite color burst"
    default y
    help
        Enables chroma burst generation and color demo output.
        Disable this to force monochrome output mode.

choice CRT_RENDER_MODE
    prompt "Demo render mode"
    default CRT_RENDER_MODE_COMPOSE
    help
        Select the app_main rendering path used for on-device bring-up.

config CRT_RENDER_MODE_COMPOSE
    bool "Tile compositor with grayscale DAC palette"

config CRT_RENDER_MODE_RGB332_FB
    bool "Direct RGB332 framebuffer"
    depends on CRT_ENABLE_COLOR
    help
        Uses the ESP_8_BIT-derived RGB332 composite color tables to render
        a 256x240 framebuffer directly, bypassing the tile compositor.

config CRT_RENDER_MODE_CALIBRATION
    bool "RGB332 calibration card"
    depends on CRT_ENABLE_COLOR
    help
        Pre-renders a deterministic RGB332 calibration card with color bars,
        phase stripes, a safe-area frame, center crosshair, and grayscale ramp.

config CRT_RENDER_MODE_RGB332_COMPOSE
    bool "Tile compositor with RGB332 composite color"
    depends on CRT_ENABLE_COLOR
    help
        Uses the tile + sprite compositor in a 256x240 logical RGB332 scene,
        then expands each composed scanline to 768 DAC samples with the
        ESP_8_BIT-derived composite color tables.

config CRT_RENDER_MODE_STIMULUS
    bool "Measurement stimulus compositor"
    help
        Uses crt_stimulus as an opaque compositor base layer to emit
        deterministic ramps, markers, PRBS, impulse, and chirp patterns for
        capture-card/CRT measurement loops.

endchoice

config CRT_COMPOSE_STRESS_DEMO
    bool "Stress COMPOSE demo scene"
    depends on CRT_RENDER_MODE_COMPOSE || CRT_RENDER_MODE_RGB332_COMPOSE
    default n
    help
        Replaces the default lightweight COMPOSE demo sprite setup with a
        controlled worst-case row: 8 visible sprites per scanline, scrolling
        tiles, palette-bank attributes, flips, and sprite BG-priority flags.
        This is intended for hardware timing smoke tests, not as the default
        visual demo.

config CRT_ENABLE_UART_UPLOAD
    bool "Enable UART framebuffer upload"
    default n
    help
        Enables the experimental UART0 raw framebuffer upload protocol used
        by tools/crt_monitor. Keep this disabled for timing-stability runs
        because bulk UART transfers can contend with the realtime pipeline.

config CRT_ENABLE_ECHOES_AUDIO
    bool "Enable embedded demo audio PWM"
    default n
    help
        Enables the embedded 8-bit PCM demo audio through LEDC PWM. Keep this
        disabled for clean video captures unless the audio output is filtered
        and routed away from GPIO25. A raw PWM carrier on GPIO26 can capacitively
        couple into the DAC video output and create vertical stripe artifacts.

config CRT_ECHOES_AUDIO_GPIO
    int "Embedded demo audio PWM GPIO"
    depends on CRT_ENABLE_ECHOES_AUDIO
    range 0 33
    default 18
    help
        GPIO used for LEDC PWM audio. Prefer a pin physically and electrically
        away from GPIO25. Avoid GPIO26 for clean composite video; avoid flash
        pins and input-only pins.

config CRT_ECHOES_PWM_FREQ_HZ
    int "Embedded demo audio PWM carrier frequency"
    depends on CRT_ENABLE_ECHOES_AUDIO
    range 20000 1000000
    default 312500
    help
        LEDC PWM carrier for embedded PCM audio. This must be filtered before
        amplification. Frequencies that alias into the visible scanline domain
        can produce stable vertical interference patterns.

config CRT_TEST_STANDARD_TOGGLE
    bool "Test mode: auto-toggle NTSC/PAL"
    default n
    help
        Automatically alternates between NTSC and PAL at runtime.
        Useful for CRT compatibility testing.

config CRT_TEST_STANDARD_TOGGLE_INTERVAL_S
    int "Test mode toggle interval (seconds)"
    depends on CRT_TEST_STANDARD_TOGGLE
    range 1 120
    default 5
    help
        Number of seconds to keep each video standard before toggling.

endmenu
```
